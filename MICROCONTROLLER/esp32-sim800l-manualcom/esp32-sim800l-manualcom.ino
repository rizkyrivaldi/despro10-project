#include <HardwareSerial.h>
HardwareSerial sim(1);
String data_in;
char data;

// String head0 = "POST " + serverPath + " HTTP/1.1\r\n" + "Host: " + serverName + "\r\n";
String content_param = "multipart/form-data; boundary=ThisIsABoundary ";
String head = "--ThisIsABoundary\\r\\nContent-Disposition: form-data; name=\"imageFile\"; filename=\"esp32-cam.jpg\"\\r\\nContent-Type: image/jpeg\\r\\n\\r\\n";
String tail = "\\r\\n--ThisIsABoundary--\\r\\n";
String url = "http://desprokel10.ddns.net:1234/upload.php";

byte picture[] = {
  0xFF, 0xD8, 0xFF, 0xE0, 0x00, 0x10, 0x4A, 0x46, 0x49, 0x46, 0x00, 0x01,
  0x01, 0x00, 0x00, 0x01, 0x00, 0x01, 0x00, 0x00, 0xFF, 0xDB, 0x00, 0x43,
  0x00, 0x06, 0x04, 0x04, 0x04, 0x05, 0x04, 0x06, 0x05, 0x05, 0x06, 0x09,
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  0x10, 0xBF, 0xA2, 0x57, 0x62, 0xC3, 0xFF, 0xD9
};

void setup() {
  Serial.begin(115200);
  // sim.begin(9600, SERIAL_8N1, 16, 17); //RX TX
  sim.begin(9600, SERIAL_8N1, 12, 13); //RX TX
}

void loop() {
  while (Serial.available()) {
    data_in = Serial.readString();
    if(data_in == "sendpicture"){
      sendPicture();
    }
    else if(data_in == "inithttp"){
      initHTTP();
    }
    else{
      sim.println(data_in);
      Serial.println("Data Sent: " + data_in);
    }

  }
  // sim.println("AT");

  while (sim.available()){
    Serial.write(sim.read());
  }
}

/*
AT+SAPBR=3,1,"Contype","GPRS"
AT+CSTT="byu","",""
AT+SAPBR=1,1
AT+HTTPINIT
AT+HTTPPARA="CID",1
AT+HTTPPARA="URL","http://miliohm.com/miliohmSIM800L.php"
AT+HTTPACTION=0
AT+HTTPREAD
*/

void sendPicture(){
  Serial.println("Sending picture...");

  // sim.println("AT+HTTPPARA=URL," + url);
  response();

  // Set HTTP content header
  delay(100);
  // Set data length
  int datalen = sizeof(head) + sizeof(tail) + sizeof(picture);

  sim.println("AT+HTTPPARA=\"CONTENT\",\"" + content_param + "Content-Length: " + String(datalen) + "\"");
  response();
  delay(100);

  
  
  // Serial.println("Data Sent: AT+HTTPDATA=" + String(datalen) + ",120000\n\n");
  // Serial.println("Packet size: " + String(datalen));
  delay(100);
  sim.println("AT+HTTPDATA=" + String(datalen) + ",120000");
  sim.println("AT");
  delay(100);

  Serial.println("Printing header...");
  sim.print(head);
  // uint8_t *fbBuf = picture;
  // size_t fbLen = sizeof(picture);
  // for (size_t n=0; n<fbLen; n=n+1024) {
  //   if (n+1024 < fbLen) {
  //     sim.write(fbBuf, 1024);
  //     fbBuf += 1024;
  //   }
  //   else if (fbLen%1024>0) {
  //     size_t remainder = fbLen%1024;
  //     sim.write(fbBuf, remainder);
  //   }
  //   Serial.println("Buffer number:" + String(n));
  // }   
  for(int i = 0; i < datalen; i++){
    sim.write(picture[i]);
  }
  Serial.println("Printing tail...");
  sim.print(tail);
  sim.println();
  Serial.println("End of upload");
}

void initHTTP(){
  sim.println("AT+SAPBR=3,1,\"Contype\",\"GPRS\"");
  response();
  sim.println("AT+CSTT=\"byu\",\"\",\"\"");
  response();
  sim.println("AT+SAPBR=1,1");
  response();
  sim.println("AT+HTTPINIT");
  response();
  sim.println("AT+HTTPPARA=\"CID\",1");
  response();
}

void response(){
  while(sim.available()){
    Serial.write(sim.read());
  }
}