#include <WiFi.h>

// Wifi Setup
const char* ssid = "DFortress_Micro";
const char* password = "darkwingxmod";
String serverName = "192.168.2.10";
String serverPath = "/upload.php";
const int serverPort = 8888;

byte picture[] = {
  0xFF, 0xD8, 0xFF, 0xE0, 0x00, 0x10, 0x4A, 0x46, 0x49, 0x46, 0x00, 0x01,
  0x01, 0x00, 0x00, 0x01, 0x00, 0x01, 0x00, 0x00, 0xFF, 0xDB, 0x00, 0x43,
  0x00, 0x06, 0x04, 0x04, 0x04, 0x05, 0x04, 0x06, 0x05, 0x05, 0x06, 0x09,
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  0x10, 0xBF, 0xA2, 0x57, 0x62, 0xC3, 0xFF, 0xD9
};

WiFiClient client;

void setup() {
  // put your setup code here, to run once:
  initWifi();
  uploadPhoto();
}

void loop() {
  // put your main code here, to run repeatedly:

}

void initWifi(){
  WiFi.mode(WIFI_STA);
  Serial.println();
  Serial.print("Connecting to ");
  Serial.println(ssid);
  WiFi.begin(ssid, password);
  while (WiFi.status() != WL_CONNECTED) {
    Serial.print(".");
    delay(500);
  }
  Serial.println();
  Serial.print("ESP32-CAM IP Address: ");
  Serial.println(WiFi.localIP());
}

void uploadPhoto(){
  String getAll;
  String getBody;

  if (client.connect(serverName.c_str(), serverPort)){

    Serial.println("Connection successful!");    
    String head = "--ThisIsABoundary\r\nContent-Disposition: form-data; name=\"imageFile\"; filename=\"esp32-cam.jpg\"\r\nContent-Type: image/jpeg\r\n\r\n";
    String tail = "\r\n--ThisIsABoundary--\r\n";

    uint32_t imageLen = sizeof(picture);
    uint32_t extraLen = head.length() + tail.length();
    uint32_t totalLen = imageLen + extraLen;

    client.print("POST " + serverPath + " HTTP/1.1\r\n");
    client.print("Host: " + serverName + "\r\n");
    client.print("Content-Length: " + String(totalLen) + "\r\n");
    client.print("Content-Type: multipart/form-data; boundary=ThisIsABoundary\r\n");
    client.print("\r\n");
    client.print(head);

    uint8_t *fbBuf = picture;
    size_t fbLen = sizeof(picture);
    for (size_t n=0; n<fbLen; n=n+1024) {
      if (n+1024 < fbLen) {
        client.write(fbBuf, 1024);
        fbBuf += 1024;
      }
      else if (fbLen%1024>0) {
        size_t remainder = fbLen%1024;
        client.write(fbBuf, remainder);
      }
    }   
    client.print(tail);

    // Waiting for response from the php server
    int timeoutTimer = 10000;
    long startTimer = millis();
    bool state = false;
    bool feedback = false;

    Serial.println("\r\nWaiting for server response...");
    while((startTimer + timeoutTimer) > millis()){
      Serial.print(".");
      delay(100);
      while(client.available()){
        char c = client.read();
        if (c == '\n'){
          if (getAll.length()==0){
            state = true;
          }

          getAll = "";
        }

        else if (c != '\r'){
          getAll += String(c);
        }

        if (state == true){
          getBody += String(c);
        }

        startTimer = millis();
      }

      if (getBody.length() > 0){
        feedback = true;
        break;
      }

    }
    Serial.println();
    client.stop();
    Serial.println(getBody);
  }

}
